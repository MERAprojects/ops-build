## yocto/openswitch/meta-platform-openswitch-baikal-qemu/conf/layer.conf
```bitbake
# We have a conf and classes directory, add to BBPATH
BBPATH := "${LAYERDIR}:${BBPATH}"

# We have a packages directory, add to BBFILES
BBFILES := "${BBFILES} ${LAYERDIR}/recipes-*/*/*.bb \
            ${LAYERDIR}/recipes-*/*/*.bbappend"

BBFILE_COLLECTIONS += "openswitch-baikal-qemu"
BBFILE_PATTERN_openswitch-baikal-qemu := "^${LAYERDIR}/"
BBFILE_PRIORITY_openswitch-baikal-qemu = "11"
```

## yocto/openswitch/meta-platform-openswitch-baikal/conf/machine/baikal.conf
```bitbake
DEFAULTTUNE ?= "mips32r2"
require conf/machine/include/qemu.inc
require conf/machine/include/tune-mips32r2.inc
#require conf/machine/include/qemuboot-mips.inc

IMAGE_FEATURES[validitems] += "ops-p4"

MACHINE_EXTRA_RRECOMMENDS += "linux-firmware"

GLIBC_ADDONS = "nptl"

IMAGE_FSTYPES = "tar.gz"
KERNEL_IMAGETYPE = "vmlinux"
MACHINE_FEATURES = "usbhost pci ext2 ext3 vfat serial \
    ops-container ops-container-coredump"
MACHINE_ESSENTIAL_EXTRA_RDEPENDS += " \
  packagegroup-ops-min \
  packagegroup-ops-min-debug \
  packagegroup-ops-base \
  packagegroup-ops-core \
"

# Why IMAGE_FEATURES and not MACHINE_FEATURES? Because MACHINE_FEATURES
# is unconditionally set above, while IMAGE_FEATURES is the combination
# of IMAGE_FEATURES specified elsewhere and IMAGE_EXTRA_FEATURES
# specified in local.conf
MACHINE_ESSENTIAL_EXTRA_RDEPENDS += \
  "${@bb.utils.contains("MACHINE_FEATURES", "ops-container", "packagegroup-ops-container", "", d)}"

PREFERRED_PROVIDER_virtual/ops-switchd-switch-api-plugin ?= \
  "${@bb.utils.contains("IMAGE_FEATURES", "ops-p4", "ops-switchd-p4switch-plugin", "ops-switchd-container-plugin", d)}"

# Allow login root with no password and enable vagrant tweaks
# EXTRA_IMAGE_FEATURES += "debug-tweaks"
```
